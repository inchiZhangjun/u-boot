## configs/qemu_inchi_arm64_defconfig
```kconfig
CONFIG_ARM=y
CONFIG_ARCH_QEMU=y
CONFIG_SYS_MALLOC_LEN=0x100000
CONFIG_NR_DRAM_BANKS=1
CONFIG_HAS_CUSTOM_SYS_INIT_SP_ADDR=y
CONFIG_CUSTOM_SYS_INIT_SP_ADDR=0x10200000
CONFIG_TEXT_BASE=0x10000000
CONFIG_ENV_SIZE=0x40000
CONFIG_ENV_SECT_SIZE=0x40000
CONFIG_DEFAULT_DEVICE_TREE="qemu-arm64"
CONFIG_DEBUG_UART_BASE=0x20000000
CONFIG_DEBUG_UART_CLOCK=20000000
CONFIG_ARMV8_CRYPTO=y
CONFIG_SYS_LOAD_ADDR=0x10200000
CONFIG_ENV_ADDR=0x4000000
CONFIG_DEBUG_UART=y
CONFIG_AHCI=y
# CONFIG_USE_PREBOOT=y
# CONFIG_DISPLAY_CPUINFO is not set
# CONFIG_DISPLAY_BOARDINFO is not set
CONFIG_SYS_CBSIZE=51
CONFIG_SYS_PBSIZE=53
# CONFIG_MMC is not set
# CONFIG_SCSI=y
CONFIG_SYS_NS16550=y
CONFIG_SYS_NS16550_MEM32=y
CONFIG_DEBUG_UART_SHIFT=2
CONFIG_SYSRESET=y
```
