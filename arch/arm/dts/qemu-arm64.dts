// SPDX-License-Identifier: GPL-2.0+ OR MIT
/*
 * Empty device tree for qemu_arm64

 * Copyright 2021 Google LLC
 */

/dts-v1/;

/ {
	cpus: cpus {
		#address-cells = <1>;
		#size-cells = <0>;
		// enable-method = "brcm,bcm2836-smp"; // for ARM 32-bit

		cpu0: cpu@0 {
			device_type = "cpu";
			compatible = "arm,cortex-a55";
			reg = <0>;
			enable-method = "spin-table";
			cpu-release-addr = <0x0 0x000000d8>;
		};

		cpu1: cpu@1 {
			device_type = "cpu";
			compatible = "arm,cortex-a55";
			reg = <1>;
			enable-method = "spin-table";
			cpu-release-addr = <0x0 0x000000e0>;
		};
	};

};
